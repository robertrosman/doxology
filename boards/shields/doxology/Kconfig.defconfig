## boards/shields/doxology/Kconfig.defconfig
```kconfig
# Copyright (c) 2022 The ZMK Contributors
# SPDX-License-Identifier: MIT

if SHIELD_DOXOLOGY

config ZMK_KEYBOARD_NAME
    default "Doxology"

endif
```

## config/west.yml
```yaml
manifest:
  remotes:
    - name: zmkfirmware
      url-base: https://github.com/petejohanson
    - name: badjeff
      url-base: https://github.com/badjeff
    - name: robertrosman
      url-base: https://github.com/robertrosman
  projects:
    - name: zmk
      remote: zmkfirmware
      revision: feat/pointers-move-scroll
      import: app/west.yml
    - name: zmk-pmw3610-driver
      remote: badjeff
      revision: main
    - name: zmk-input-behavior-listener
      remote: robertrosman
      revision: main
  self:
    path: config
```
